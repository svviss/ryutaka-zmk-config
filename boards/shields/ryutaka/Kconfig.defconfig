## boards/shields/ryutaka/Kconfig.defconfig
```kconfig
if SHIELD_RYUTAKA_LEFT

# Name must be less than 16 characters long!
config ZMK_KEYBOARD_NAME
    default "Ryutaka"

config ZMK_SPLIT_ROLE_CENTRAL
    default y

endif

if SHIELD_RYUTAKA_LEFT || SHIELD_RYUTAKA_RIGHT

config ZMK_SPLIT
    default y

endif
```

## boards/shields/ryutaka/Kconfig.shield
```kconfig
config SHIELD_RYUTAKA_LEFT
    def_bool $(shields_list_contains,ryutaka_left)

config SHIELD_RYUTAKA_RIGHT
    def_bool $(shields_list_contains,ryutaka_right)
```
